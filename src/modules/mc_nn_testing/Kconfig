## src/modules/mc_nn_testing/Kconfig
```kconfig
menuconfig MODULES_MC_NN_TESTING
	bool "mc_nn_testing"
	default n
	---help---
		Enable support for mc_nn_testing"

menuconfig USER_MC_NN_TESTING
	bool "mc_nn_testing running as userspace module"
	default y
	depends on BOARD_PROTECTED && MODULES_MC_NN_TESTING
	---help---
		Put mc_nn_testing in userspace memory
```
